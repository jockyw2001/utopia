## UTPA2-700.0.x/modules/graphic/drv/gopsc/Kconfig
```kconfig
config DRV_GOPSC

tristate "GOPSC"
default n

---help---
Enable compilation option for driver GOPSC
```

## UTPA2-700.0.x/modules/graphic/drv/gopscd/Kconfig
```kconfig
config DRV_GOPSC_EX

tristate "GOPSC_EX"
default n

---help---
Enable compilation option for driver GOPSC_EX
```

## UTPA2-700.0.x/modules/hdmi/api/cec/Kconfig
```kconfig
config API_CEC

tristate "CEC"
default n

---help---
Enable compilation option for API CEC
```

## UTPA2-700.0.x/modules/hdmi/api/hdmitx/Kconfig
```kconfig
config API_HDMITX

tristate "HDMITX"
default n

---help---
Enable compilation option for API HDMITX
```

## UTPA2-700.0.x/modules/hdmi/api/hdmitx2/Kconfig
```kconfig
config API_HDMITX2

tristate "HDMITX2"
default n

---help---
Enable compilation option for API HDMITX2
```

## UTPA2-700.0.x/modules/hdmi/api/mhl/Kconfig
```kconfig
config API_MHL

tristate "MHL"
default n

---help---
Enable compilation option for API MHL
```

## UTPA2-700.0.x/modules/hdmi/drv/cec/Kconfig
```kconfig
config DRV_CEC

tristate "CEC"
default n

---help---
Enable compilation option for driver CEC
```

## UTPA2-700.0.x/modules/hdmi/drv/hdcp/Kconfig
```kconfig
config DRV_HDCP

tristate "HDCP"
default n

---help---
Enable compilation option for driver HDCP
```

## UTPA2-700.0.x/modules/hdmi/drv/hdmitx/Kconfig
```kconfig
config DRV_HDMITX

tristate "HDMITX"
default n

---help---
Enable compilation option for driver HDMITX
```

## UTPA2-700.0.x/modules/hdmi/drv/hdmitx2/Kconfig
```kconfig
config DRV_HDMITX2

tristate "HDMITX2"
default n

---help---
Enable compilation option for driver HDMITX2
```

## UTPA2-700.0.x/modules/hdmi/drv/mhl/Kconfig
```kconfig
config DRV_MHL

tristate "MHL"
default n

---help---
Enable compilation option for driver MHL
```

## UTPA2-700.0.x/modules/hsl/api/hsl/Kconfig
```kconfig
config API_HSL

tristate "HSL"
default n

---help---
Enable compilation option for API HSL
```

## UTPA2-700.0.x/modules/hwi2c/drv/hwi2c/Kconfig
```kconfig
config DRV_HWI2C

tristate "HWI2C"
default n

---help---
Enable compilation option for driver HWI2C

config MSTAR_UTPA2K_HWI2C_ENABLE
    bool "Enable Mstar UTPA2K HWI2C"
    default n
    help
       Select if you want to enable UTPA2K
config MSTAR_HWI2C_KERNEL_MODE
    bool "Enable HWI2C Kernel Mode"
    default n
    help
       Select if you want to enable KernelMode

if DRV_HWI2C
config HWIIC_INTERRUPT_MODE_ENABLE
	bool "Enable HWIIC interrupt mode"
	default n
	help
	  Select if you want to enable HWIIC interrupt mode. If unsure, say 'N'.

endif
```

## UTPA2-700.0.x/modules/ipauth/drv/ipauth/Kconfig
```kconfig
config DRV_IPAUTH

tristate "IPAUTH"
default n

---help---
Enable compilation option for driver IPAUTH
```

## UTPA2-700.0.x/modules/ir/drv/ir/Kconfig
```kconfig
config DRV_IR

tristate "IR"
default n

---help---
Enable compilation option for driver IR
```

## UTPA2-700.0.x/modules/ir_tx/drv/ir_tx/Kconfig
```kconfig
config DRV_IR_TX

tristate "IR_TX"
default n

---help---
Enable compilation option for driver IR TX
```

## UTPA2-700.0.x/modules/irq/drv/irq/Kconfig
```kconfig
config DRV_IRQ

tristate "IRQ"
default n

---help---
Enable compilation option for driver IRQ
```

## UTPA2-700.0.x/modules/ldm/drv/ldm/Kconfig
```kconfig
config DRV_LDM

tristate "local dimming"
default n

---help---
Enable compilation option for driver local dimming
```

## UTPA2-700.0.x/modules/ldm/drv/ldma/Kconfig
```kconfig
config DRV_LDM_DMA

tristate "LDMA"
default n

---help---
Enable compilation option for driver Local dimming DMA
```

## UTPA2-700.0.x/modules/mbx/api/mbx/Kconfig
```kconfig
config API_MBX

tristate "MBX"
default y

---help---
Enable compilation option for API MBX

if API_MBX
config MBX_GROUP_PATCH
	bool "Enable MBX group patch"
	default n
	help
		Select if you want to enable MBX Group patch. If unsure, say 'N'.

endif
```

## UTPA2-700.0.x/modules/mbx/drv/mbx/Kconfig
```kconfig
config DRV_MBX

tristate "MBX"
default y

---help---
Enable compilation option for driver MBX
```

## UTPA2-700.0.x/modules/mfc/drv/mfc/Kconfig
```kconfig
config DRV_MFC

tristate "MFC"
default n

---help---
Enable compilation option for driver MFC
```

## UTPA2-700.0.x/modules/mfe/api/mfe/Kconfig
```kconfig
config API_MFE

tristate "MFE"
default n

---help---
Enable compilation option for API MFE
```

## UTPA2-700.0.x/modules/mfe/api/mfe_ex/Kconfig
```kconfig
config API_MFE_EX

tristate "MFE_EX"
default n

---help---
Enable compilation option for API MFE_EX
```

## UTPA2-700.0.x/modules/mfe/drv/mfe/Kconfig
```kconfig
config DRV_MFE

tristate "MFE"
default n

---help---
Enable compilation option for driver MFE
```
