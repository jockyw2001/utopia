## UTPA2-700.0.x/modules/acp/api/acp/Kconfig
```kconfig
config API_ACP

tristate "ACP"
default n

---help---
Enable compilation option for API ACE
```

## UTPA2-700.0.x/modules/audio/api/audio/Kconfig
```kconfig
config API_AUDIO

tristate "AUDIO"
default n

---help---
Enable compilation option for API AUDIO
```

## UTPA2-700.0.x/modules/audio/drv/audio/Kconfig
```kconfig
config DRV_AUDIO

tristate "AUDIO"
default n

---help---
Enable compilation option for driver AUDIO
```

## UTPA2-700.0.x/modules/audio/drv/audsp/Kconfig
```kconfig
config DRV_AUDSP

tristate "AUDSP"
default n

---help---
Enable compilation option for driver AUDSP
```

## UTPA2-700.0.x/modules/bdma/drv/bdma/Kconfig
```kconfig
config DRV_BDMA

tristate "BDMA"
default n

---help---
Enable compilation option for driver BDMA
```

## UTPA2-700.0.x/modules/ch34/drv/ch34/Kconfig
```kconfig
config DRV_CH34

tristate "CH34"
default n

---help---
Enable compilation option for driver CH34
```

## UTPA2-700.0.x/modules/clkm/drv/clkm/Kconfig
```kconfig
config MSTAR_CLKM

tristate "CLKM"
default n

---help---
Enable compilation option for driver CLKM

config MSTAR_SRAMPD
	bool "Enable Sram pd"
	default n
	help
	  Select if you want to enable sram pd. If unsure, say 'N'.
	  
```

## UTPA2-700.0.x/modules/cmdq/drv/cmdq/Kconfig
```kconfig
config DRV_CMDQ

tristate "CMDQ"
default n

---help---
Enable compilation option for driver CMDQ
```

## UTPA2-700.0.x/modules/cpu/drv/cpu/Kconfig
```kconfig
config DRV_CPU

tristate "CPU"
default n

---help---
Enable compilation option for driver CPU
```

## UTPA2-700.0.x/modules/dac/api/dac/Kconfig
```kconfig
config API_DAC

tristate "DAC"
default n

---help---
Enable compilation option for API DAC
```

## UTPA2-700.0.x/modules/dac/drv/dac/Kconfig
```kconfig
config DRV_DAC

tristate "DAC"
default n

---help---
Enable compilation option for driver DAC
```

## UTPA2-700.0.x/modules/ddc2bi/drv/ddc2bi/Kconfig
```kconfig
config DRV_DDC2BI

tristate "DDC2BI"
default n

---help---
Enable compilation option for driver DDC2BI
```

## UTPA2-700.0.x/modules/demodulator/drv/demod/Kconfig
```kconfig
config DRV_DEMOD

tristate "DEMOD"
default n

config AMAZON
prompt "External demod: amazon"
bool
default n

---help---
Enable compilation option for driver DEMOD
```

## UTPA2-700.0.x/modules/demodulator/drv/dmd/Kconfig
```kconfig
config DRV_DMD

tristate "DMD"
default n

---help---
Enable compilation option for driver DMD
```

## UTPA2-700.0.x/modules/demodulator/drv/dvb_extdemod/Kconfig
```kconfig
config DRV_MSB1233

tristate "MSB1233"
default n

---help---
Enable compilation option for driver MSB1233
```

## UTPA2-700.0.x/modules/dlc/api/dlc/Kconfig
```kconfig
config API_DLC

tristate "DLC"
default n

---help---
Enable compilation option for API DLC
```

## UTPA2-700.0.x/modules/dlc/drv/dlc/Kconfig
```kconfig
config DRV_DLC

tristate "DLC"
default n

---help---
Enable compilation option for driver DLC
```

## UTPA2-700.0.x/modules/dms/api/dms/Kconfig
```kconfig
config API_DMS

tristate "DMS"
default n

---help---
Enable compilation option for API DMS
```

## UTPA2-700.0.x/modules/dms/drv/dms_dipgop/Kconfig
```kconfig
config DRV_DMS

tristate "DMS"
default n

---help---
Enable compilation option for driver DMS
```

## UTPA2-700.0.x/modules/dmx/api/dmx/Kconfig
```kconfig
config API_DMX

tristate "DMX"
default n

---help---
Enable compilation option for API DMX

if API_DMX

config DMX_UTOPIA_20_ENABLE
	bool "Enable DMX 20"
	default y
	help
	  Select if you want to enable DMX Utopia 2_0. If unsure, say 'Y'.

config STC64_ENABLE
	bool "Enable STC64"
	default y
	help
	  Select if you want to enable STC64. If unsure, say 'Y'.

config VQ_ENABLE
	bool "Enable VQ"
	default y
	help
	  Select if you want to enable VQ. If unsure, say 'Y'.

config FIVQ_ENABLE
	bool "Enable File-in VQ"
	default y
	help
	  Select if you want to enable VQ. If unsure, say 'Y'.

config FQ_ENABLE
    bool "Enable FQ"
    default n
    help
      Select if you want to enable FQ. If unsure, say 'N'.

config EXT_FILTER_ENABLE
	bool "Enable Externel Filter"
	default n
	help
	  Select if you want to enable externel filter. If unsure, say 'N'.

config TSP2_ENABLE
	bool "Enable TS2"
	default n
	help
	  Select if you want to enable TS2. If unsure, say 'N'.

config TSP3_ENABLE
	bool "Enable TS3"
	default n
	help
	  Select if you want to enable TS3 IF. If unsure, say 'N'.

config MMFILEIN_ENABLE
	bool "Enable MM file in"
	default y
	help
	  Select if you want to enable MM file in. If unsure, say 'Y'.

config MMFI3D_ENABLE
	bool "Enable MM file in 3D"
	default n
	help
	  Select if you want to enable MM file in 3D. If unsure, say 'N'.

config MMFI2_EXTRA_AUFIFO_ENABLE
	bool "Enable Extra AU FIFOs"
	default n
	help
	  Select if you want to enable extra audio fifos. If unsure, say 'N'.

config MOBF_ENABLE
	bool "Enable MOBF"
	default n
	help
	  Select if you want to enable MOBF. If unsure, say 'N'.

config MMFIMOBF_ENABLE
	bool "Enable MM file in MOBF"
	default n
	help
	  Select if you want to enable MM file in MOBF. If unsure, say 'N'.

config USE_HWPCR_ENABLE
	bool "Enable HW PCR"
	default n
	help
	  Select if you want to enable HW PCR. If unsure, say 'N'.

config DMX_DEBUG_TABLE_ENABLE
	bool "Enable Debug Table"
	default n
	help
	  Select if you want to enable debug table. If unsure, say 'N'.

config TSP3_DULFLT_ENABLE
	bool "Enable TSP3 Duplicate Filter"
	default n
	help
	  Select if you want to enable TSP3 duplicate filters. If unsure, say 'N'.

config EXTRA_PVR1_FLT_ENABLE
	bool "Enable Extra PVR1 Filter"
	default n
	help
	  Select if you want to enable extra pvr1 filter. If unsure, say 'N'.

config TS2_LIVE_ENABLE
	bool "Enable TS2 Live"
	default n
	help
	  Select if you want to enable TS2 live path. If unsure, say 'N'.

config RASP_SUPPORT
	bool "Enable RASP Support"
	default n
	help
	  Select if you want to enable RASP. If unsure, say 'N'.

config TSIO_SUPPORT
	bool "Enable TSIO Support"
	default n
	help
	  Select if you want to enable tso. If unsure, say 'N'.

config TSO_SUPPORT
	bool "Enable TSO Support"
	default n
	help
	  Select if you want to enable tso. If unsure, say 'N'.

config TSO_VER_20_SUPPORT
	bool "Enable TSO Version 2.0 Support"
	default n
	help
	  Select if you want to enable tso. If unsure, say 'N'.

config TSO_HW_BOX_SERIES
	bool "Enable TSO BOX Series Support"
	default n
	help
	  Select if you want to enable tso. If unsure, say 'N'.

config MERGE_STREAM_SUPPORT
	bool "Enable Merge Stream Support"
	default n
	help
	  Select if you want to enable tso. If unsure, say 'N'.

config GENERAL_DSCMB_SUPPORT
	bool "Enable General DSCMB Support"
	default n
	help
	  Select if you want to enable tso. If unsure, say 'N'.

config OTV_SUPPORT
	bool "Enable OTV Support"
	default n
	help
	  Select if you want to enable OTV. If unsure, say 'N'.

config SECURE_PVR_SUPPORT
	bool "Secure PVR Support"
	default n
	help
	  Select if you want to enable secure pvr. If unsure, say 'N'.

config TSO_PVR_SUPPORT
	bool "TSO PVR Support"
	default n
	help
	  Select if you want to enable tso pvr. If unsure, say 'N'.

endif
```

## UTPA2-700.0.x/modules/dmx/api/dmx_tee/Kconfig
```kconfig
config API_DMX_TEE

tristate "DMX_TEE"
default n

---help---
Enable compilation option for API DMX_TEE
```

## UTPA2-700.0.x/modules/dmx/drv/fq/Kconfig
```kconfig
config DRV_RASP

tristate "RASP"
default n

---help---
Enable compilation option for driver RASP
```

## UTPA2-700.0.x/modules/dmx/drv/mmfi/Kconfig
```kconfig
config DRV_MMFI

tristate "MMFI"
default n

---help---
Enable compilation option for driver MMFI
```

## UTPA2-700.0.x/modules/dmx/drv/mmfi2/Kconfig
```kconfig
config DRV_MMFI2

tristate "MMFI2"
default n

---help---
Enable compilation option for driver MMFI2
```

## UTPA2-700.0.x/modules/dmx/drv/otv/Kconfig
```kconfig
config DRV_OTV

tristate "OTV"
default n

---help---
Enable compilation option for driver OTV
```
