## UTPA2-700.0.x/modules/vdec_v2/api/vdec_ex/Kconfig
```kconfig
config API_VDEC_EX

tristate "VDEC_EX"
default n

---help---
Enable compilation option for API VDEC_EX
```

## UTPA2-700.0.x/modules/vdec_v2/drv/hvd_ex/Kconfig
```kconfig
config DRV_HVD_EX

tristate "HVD_EX"
default n

---help---
Enable compilation option for driver HVD_EX
```

## UTPA2-700.0.x/modules/vdec_v2/drv/mvd_ex/Kconfig
```kconfig
config DRV_MVD_EX

tristate "MVD_EX"
default n

---help---
Enable compilation option for driver MVD_EX
```

## UTPA2-700.0.x/modules/vdec_v3/api/vdec_v3/Kconfig
```kconfig
config API_VDEC_V3

tristate "VDEC_V3"
default n

---help---
Enable compilation option for API VDEC_V3
```

## UTPA2-700.0.x/modules/vdec_v3/drv/hvd_v3/Kconfig
```kconfig
config DRV_HVD_V3

tristate "HVD_V3"
default n

---help---
Enable compilation option for driver HVD_V3
```

## UTPA2-700.0.x/modules/vdec_v3/drv/mvd_v3/Kconfig
```kconfig
config DRV_MVD_V3

tristate "MVD_V3"
default n

---help---
Enable compilation option for driver MVD_V3
```

## UTPA2-700.0.x/modules/ve/drv/ve/Kconfig
```kconfig
config DRV_VE

tristate "VE"
default n

---help---
Enable compilation option for driver VE
```

## UTPA2-700.0.x/modules/vif/drv/vif/Kconfig
```kconfig
config DRV_VIF

tristate "VIF"
default n

---help---
Enable compilation option for driver VIF
```

## UTPA2-700.0.x/modules/wble/drv/wble/Kconfig
```kconfig
config DRV_WBLE

tristate "WBLE"
default n

---help---
Enable compilation option for driver WBLE
```

## UTPA2-700.0.x/modules/wdt/drv/wdt/Kconfig
```kconfig
config DRV_WDT

tristate "WDT"
default n

---help---
Enable compilation option for driver WDT

config MSTAR_UTPA2K_WDT_ENABLE
    bool "Enable Mstar UTPA2K WDT"
    default n
    help
       Select if you want to enable UTPA2K
config MSTAR_WDT_KERNEL_MODE
    bool "Enable WDT Kernel Mode"
    default n
    help
       Select if you want to enable KernelMode
```

## UTPA2-700.0.x/modules/xc/api/ace/Kconfig
```kconfig
config API_ACE

tristate "ACE"
default n

---help---
Enable compilation option for API ACE
```

## UTPA2-700.0.x/modules/xc/api/pnl/Kconfig
```kconfig
config API_PNL

tristate "PNL"
default n

---help---
Enable compilation option for API PNL
```

## UTPA2-700.0.x/modules/xc/api/xc/Kconfig
```kconfig
config API_XC

tristate "XC"
default n

---help---
Enable compilation option for API XC

---help---
Enable compilation option for API XC
if API_XC
config XC_SEAMLESS_SCALING
	bool "Enable XC SEAMLESS SCALING"
	default n
	help
	  Select if you want to enable XC SEAMLESS SCALING. If unsure, say 'N'.
	  
config XC_4K2K_PATCH_ENABLE
	bool "Enable XC 4K2K Patch"
	default n
	help
	  Select if you want to enable XC 4K2K patch. If unsure, say 'N'.
	  
endif
```

## UTPA2-700.0.x/modules/xc/drv/ace/Kconfig
```kconfig
config DRV_ACE

tristate "ACE"
default n

---help---
Enable compilation option for driver ACE
```

## UTPA2-700.0.x/modules/xc/drv/pnl/Kconfig
```kconfig
config DRV_PNL

tristate "PNL"
default n

---help---
Enable compilation option for driver PNL
```

## UTPA2-700.0.x/modules/xc/drv/xc/Kconfig
```kconfig
config DRV_XC

tristate "XC"
default n

---help---
Enable compilation option for driver XC
```

## UTPA2-700.0.x/mxlib/api/Kconfig
```kconfig
# mxlib/api/Kconfig

menu "Utopia API Library Selection"

#===================================================
# Utopia API Libraries
#===================================================
comment "Utopia API Libraries"

source "../../mxlib/api/ace/Kconfig"
source "../../mxlib/api/acp/Kconfig"
source "../../mxlib/api/audio/Kconfig"
source "../../mxlib/api/cec/Kconfig"
source "../../mxlib/api/dac/Kconfig"
source "../../mxlib/api/dlc/Kconfig"
source "../../mxlib/api/dmx/Kconfig"
source "../../mxlib/api/dmx_tee/Kconfig"
source "../../mxlib/api/gfx/Kconfig"
source "../../mxlib/api/gop/Kconfig"
source "../../mxlib/api/gopsc/Kconfig"
source "../../mxlib/api/gopscd/Kconfig"
source "../../mxlib/api/gpd/Kconfig"
source "../../mxlib/api/hdmitx/Kconfig"
source "../../mxlib/api/hdmitx2/Kconfig"
source "../../mxlib/api/hsl/Kconfig"
source "../../mxlib/api/jpeg/Kconfig"
source "../../mxlib/api/jpeg_ex/Kconfig"
source "../../mxlib/api/mfe/Kconfig"
source "../../mxlib/api/mfe_ex/Kconfig"
source "../../mxlib/api/mhl/Kconfig"
source "../../mxlib/api/njpeg_ex/Kconfig"
source "../../mxlib/api/pnl/Kconfig"
source "../../mxlib/api/swi2c/Kconfig"
source "../../mxlib/api/mbx/Kconfig"
source "../../mxlib/api/vdec/Kconfig"
source "../../mxlib/api/vdec_ex/Kconfig"
source "../../mxlib/api/vdec_v3/Kconfig"
source "../../mxlib/api/vdec_lite/Kconfig"
source "../../mxlib/api/xc/Kconfig"
#source "../../mxlib/api/localdimm/Kconfig"

endmenu
```

## UTPA2-700.0.x/mxlib/drv/Kconfig
```kconfig
# mxlib/drv/Kconfig

menu "Utopia Drviver Library Selection"

#===================================================
# Utopia Driver Libraries
#===================================================
comment "Utopia Driver Libraries"

source "../../mxlib/drv/ace/Kconfig"
source "../../mxlib/drv/aesdma/Kconfig"
source "../../mxlib/drv/audio/Kconfig"
source "../../mxlib/drv/audsp/Kconfig"
source "../../mxlib/drv/avd/Kconfig"
source "../../mxlib/drv/bdma/Kconfig"
source "../../mxlib/drv/ir_tx/Kconfig"
source "../../mxlib/drv/ca2/Kconfig"
source "../../mxlib/drv/cec/Kconfig"
source "../../mxlib/drv/cipher/Kconfig"
source "../../mxlib/drv/cmdq/Kconfig"
source "../../mxlib/drv/cpu/Kconfig"
source "../../mxlib/drv/ch34/Kconfig"
source "../../mxlib/drv/dac/Kconfig"
source "../../mxlib/drv/ddc2bi/Kconfig"
source "../../mxlib/drv/demod/Kconfig"
#source "../../mxlib/drv/dip/Kconfig"
source "../../mxlib/drv/dlc/Kconfig"
source "../../mxlib/drv/dmd/Kconfig"
source "../../mxlib/drv/dscmb/Kconfig"
source "../../mxlib/drv/dscmb2/Kconfig"
source "../../mxlib/drv/dvb_extdemod/Kconfig"
source "../../mxlib/drv/flash/Kconfig"
source "../../mxlib/drv/ge/Kconfig"
source "../../mxlib/drv/gop/Kconfig"
source "../../mxlib/drv/gopsc/Kconfig"
source "../../mxlib/drv/gpd/Kconfig"
source "../../mxlib/drv/gpio/Kconfig"
source "../../mxlib/drv/hdcp/Kconfig"
source "../../mxlib/drv/hdmitx/Kconfig"
source "../../mxlib/drv/hdmitx2/Kconfig"
source "../../mxlib/drv/hvd/Kconfig"
source "../../mxlib/drv/hvd_ex/Kconfig"
source "../../mxlib/drv/hvd_v3/Kconfig"
source "../../mxlib/drv/hwi2c/Kconfig"
source "../../mxlib/drv/ipauth/Kconfig"
source "../../mxlib/drv/ir/Kconfig"
source "../../mxlib/drv/irq/Kconfig"
source "../../mxlib/drv/jpd/Kconfig"
source "../../mxlib/drv/jpd_ex/Kconfig"
source "../../mxlib/drv/mbx/Kconfig"
source "../../mxlib/drv/mfc/Kconfig"
source "../../mxlib/drv/mfe/Kconfig"
source "../../mxlib/drv/mfe_ex/Kconfig"
source "../../mxlib/drv/mhl/Kconfig"
#source "../../mxlib/drv/minitsp/Kconfig"
source "../../mxlib/drv/miu/Kconfig"
source "../../mxlib/drv/mmio/Kconfig"
#source "../../mxlib/drv/mpif/Kconfig"
source "../../mxlib/msos/Kconfig"
source "../../mxlib/msfs/Kconfig"
source "../../mxlib/drv/mvd/Kconfig"
source "../../mxlib/drv/mvd_ex/Kconfig"
source "../../mxlib/drv/mvd_v3/Kconfig"
source "../../mxlib/drv/mvop/Kconfig"
source "../../mxlib/drv/mspi/Kconfig"
source "../../mxlib/drv/nsk2/Kconfig"
source "../../mxlib/drv/njpd_ex/Kconfig"
source "../../mxlib/drv/pcmcia/Kconfig"
source "../../mxlib/drv/pm/Kconfig"
source "../../mxlib/drv/pnl/Kconfig"
source "../../mxlib/drv/pwm/Kconfig"
source "../../mxlib/drv/pws/Kconfig"
source "../../mxlib/drv/rtc/Kconfig"
source "../../mxlib/drv/rvd/Kconfig"
source "../../mxlib/drv/sar/Kconfig"
source "../../mxlib/drv/sc/Kconfig"
source "../../mxlib/drv/sem/Kconfig"
source "../../mxlib/drv/smbx/Kconfig"
source "../../mxlib/drv/stbdc/Kconfig"
source "../../mxlib/drv/sys/Kconfig"
source "../../mxlib/drv/tso/Kconfig"
source "../../mxlib/drv/tsp/Kconfig"
source "../../mxlib/drv/tsp3/Kconfig"
source "../../mxlib/drv/tsp_tee/Kconfig"
source "../../mxlib/drv/mmfi/Kconfig"
source "../../mxlib/drv/mmfi2/Kconfig"
source "../../mxlib/drv/uart/Kconfig"
source "../../mxlib/drv/urdma/Kconfig"
source "../../mxlib/drv/usb_ecos/usbhost/Kconfig"
source "../../mxlib/drv/usbhost/Kconfig"
source "../../mxlib/drv/vbi/Kconfig"
source "../../mxlib/drv/ve/Kconfig"
source "../../mxlib/drv/vif/Kconfig"
source "../../mxlib/drv/wble/Kconfig"
source "../../mxlib/drv/wdt/Kconfig"
source "../../mxlib/drv/xc/Kconfig"
source "../../mxlib/drv/seal/Kconfig"
source "../../mxlib/drv/cmdq/Kconfig"
#source "../../mxlib/drv/localdimm/Kconfig"
source "../../mxlib/drv/pq/Kconfig"
source "../../mxlib/drv/pvr_iframelut/Kconfig"
source "../../mxlib/drv/clkm/Kconfig"
source "../../mxlib/drv/ldm/Kconfig"

endmenu
```

## UTPA2-700.0.x/mxlib/msfs/Kconfig
```kconfig
config MSFS

tristate "MsFS"
default n

---help---
Enable compilation option for driver MsFS
```
