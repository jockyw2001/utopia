## UTPA2-700.0.x/modules/sem/drv/sem/Kconfig
```kconfig
config DRV_SEM

tristate "SEM"
default n

---help---
Enable compilation option for driver SEM
```

## UTPA2-700.0.x/modules/smbx/drv/smbx/Kconfig
```kconfig
config DRV_SMBX

tristate "SMBX"
default n

---help---
Enable compilation option for driver SMBX
```

## UTPA2-700.0.x/modules/stbdc/drv/stbdc/Kconfig
```kconfig
config DRV_STBDC

tristate "STBDC"
default n

---help---
Enable compilation option for driver STBDC
```

## UTPA2-700.0.x/modules/swi2c/api/swi2c/Kconfig
```kconfig
config API_SWI2C

tristate "SWI2C"
default n

---help---
Enable compilation option for API SWI2C
```

## UTPA2-700.0.x/modules/sys/drv/sys/Kconfig
```kconfig
config DRV_SYS

tristate "SYS"
default n

---help---
Enable compilation option for driver SYS
```

## UTPA2-700.0.x/modules/uart/drv/uart/Kconfig
```kconfig
config DRV_UART

tristate "UART"
default n

---help---
Enable compilation option for driver UART
```

## UTPA2-700.0.x/modules/urdma/drv/urdma/Kconfig
```kconfig
config DRV_URDMA

tristate "URDMA"
default n

---help---
Enable compilation option for driver URDMA
```

## UTPA2-700.0.x/modules/usb/drv/usb_ecos/usbhost/Kconfig
```kconfig
config DRV_USB_ECOS

tristate "USB_ECOS"
default n

---help---
Enable compilation option for driver USB_ECOS
```

## UTPA2-700.0.x/modules/usb/drv/usbhost/Kconfig
```kconfig
config USBHOST

tristate "USBHOST"
default n

---help---
Enable compilation option for driver USB

if USBHOST
source "../../mxlib/drv/usbhost/source/usb_hid_p1/Kconfig"
source "../../mxlib/drv/usbhost/source/usb_host_p1/Kconfig"
source "../../mxlib/drv/usbhost/source2/usb_hid_p2/Kconfig"
source "../../mxlib/drv/usbhost/source2/usb_host_p2/Kconfig"
source "../../mxlib/drv/usbhost/source3/usb_hid_p3/Kconfig"
source "../../mxlib/drv/usbhost/source3/usb_host_p3/Kconfig"
source "../../mxlib/drv/usbhost/source4/usb_hid_p4/Kconfig"
source "../../mxlib/drv/usbhost/source4/usb_host_p4/Kconfig"
endif
```

## UTPA2-700.0.x/modules/usb/drv/usbhost/source/usb_hid_p1/Kconfig
```kconfig
config DRV_USB_HID_P1

bool "Apply HID P1"
default n

---help---
Enable compilation option for driver USB_HID_P1
```

## UTPA2-700.0.x/modules/usb/drv/usbhost/source/usb_host_p1/Kconfig
```kconfig
config DRV_USB_HOST_P1

bool "Apply Host P1"
default n

---help---
Enable compilation option for driver USB_HOST_P1
```

## UTPA2-700.0.x/modules/usb/drv/usbhost/source2/usb_hid_p2/Kconfig
```kconfig
config DRV_USB_HID_P2

bool "Apply HID P2"
default n

---help---
Enable compilation option for driver USB_HID_P2
```

## UTPA2-700.0.x/modules/usb/drv/usbhost/source2/usb_host_p2/Kconfig
```kconfig
config DRV_USB_HOST_P2

bool "Apply Host P2"
default n

---help---
Enable compilation option for driver USB_HOST_P2
```

## UTPA2-700.0.x/modules/usb/drv/usbhost/source3/usb_hid_p3/Kconfig
```kconfig
config DRV_USB_HID_P3

bool "Apply HID P3"
default n

---help---
Enable compilation option for driver USB_HID_P3
```

## UTPA2-700.0.x/modules/usb/drv/usbhost/source3/usb_host_p3/Kconfig
```kconfig
config DRV_USB_HOST_P3

bool "Apply Host P3"
default n

---help---
Enable compilation option for driver USB_HOST_P3
```

## UTPA2-700.0.x/modules/usb/drv/usbhost/source4/usb_hid_p4/Kconfig
```kconfig
config DRV_USB_HID_P4

bool "Apply HID P4"
default n

---help---
Enable compilation option for driver USB_HID_P4
```

## UTPA2-700.0.x/modules/usb/drv/usbhost/source4/usb_host_p4/Kconfig
```kconfig
config DRV_USB_HOST_P4

bool "Apply Host P4"
default n

---help---
Enable compilation option for driver USB_HOST_P4
```

## UTPA2-700.0.x/modules/vd/drv/avd/Kconfig
```kconfig
config DRV_AVD

tristate "AVD"
default n

---help---
Enable compilation option for driver AVD
```

## UTPA2-700.0.x/modules/vd/drv/vbi/Kconfig
```kconfig
config DRV_VBI

tristate "VBI"
default n

---help---
Enable compilation option for driver VBI
```

## UTPA2-700.0.x/modules/vdec_lite/api/vdec_lite/Kconfig
```kconfig
config API_VDEC_LITE

tristate "VDEC_LITE"
default n

---help---
Enable compilation option for API VDEC_LITE
```

## UTPA2-700.0.x/modules/vdec_lite/drv/hvd_lite/Kconfig
```kconfig
config DRV_HVD_LITE

tristate "HVD_LITE"
default n

---help---
Enable compilation option for driver HVD_LITE
```

## UTPA2-700.0.x/modules/vdec_lite/drv/mvd_lite/Kconfig
```kconfig
config DRV_MVD_LITE

tristate "MVD_LITE"
default n

---help---
Enable compilation option for driver MVD_LITE
```

## UTPA2-700.0.x/modules/vdec_v1/api/vdec/Kconfig
```kconfig
config API_VDEC

tristate "VDEC"
default n

---help---
Enable compilation option for API VDEC
```

## UTPA2-700.0.x/modules/vdec_v1/drv/mvd/Kconfig
```kconfig
config DRV_MVD

tristate "MVD"
default n

---help---
Enable compilation option for driver MVD
```

## UTPA2-700.0.x/modules/vdec_v1/drv/rvd/Kconfig
```kconfig
config DRV_RVD

tristate "RVD"
default n

---help---
Enable compilation option for driver RVD
```
