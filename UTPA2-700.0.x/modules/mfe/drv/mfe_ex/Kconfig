## UTPA2-700.0.x/modules/mfe/drv/mfe_ex/Kconfig
```kconfig
config DRV_MFE_EX

tristate "MFE_EX"
default n

---help---
Enable compilation option for driver MFE_EX
```

## UTPA2-700.0.x/modules/miu/drv/miu/Kconfig
```kconfig
config DRV_MIU

tristate "MIU"
default n

---help---
Enable compilation option for driver MIU
```

## UTPA2-700.0.x/modules/msos/drv/mmio/Kconfig
```kconfig
config DRV_MMIO

tristate "MMIO"
default n

---help---
Enable compilation option for driver MMIO
```

## UTPA2-700.0.x/modules/msos/msos/Kconfig
```kconfig
config MSOS
	tristate "MsOS"
	default n

config INT_SPI_MODE
	tristate "Interrupt spi mode"
	default n
---help---
Enable compilation option for driver MsOS
```

## UTPA2-700.0.x/modules/msos/utopia_core/Kconfig
```kconfig
#
# Utopia framework configuration
#

menu "Utoipa framework"

config UTOPIA_TEE
	bool "Flag of CONFIG_UTOPIA_TEE"
	default n

	config UTOPIA_DRIVER_STRUCT_PACKED
    bool "Support struct Packed"
	default y

config UTOPIA_FRAMEWORK
	bool "Support for utopia framework"
	default n
if UTOPIA_FRAMEWORK	
    config UTOPIA_FRAMEWORK_KERNEL_DRIVER
    bool "Support for utopia2k framework"
	default n
	
	config UTOPIA_FRAMEWORK_KERNEL_DRIVER_64BIT
    bool "Support for utopia2k 64bit framework"
	default n

	config UTOPIA_FRAMEWORK_KERNEL_DRIVER_32BIT
    bool "Support for utopia2k 32bit framework"
	default n

	config UTOPIA_FRAMEWORK_DISABLE_SYSTEM_V_IPCS
	bool "Disable System V IPCs"
	default n
	
	config UTOPIAXP_PATCH
    bool "Enable utopia XP hard-cored patch"
	default n

	config UTOPIAXP_CONF_PATH
	string "Default path for utopia.conf"
	default "/applications/utopia.conf"

	config UTOPIA_MODE_DEFAULT_KERNEL
	bool "Default using kernel mode utopia"
	default n
	help
		Do not reference utopia.conf, default using kernel mode utopia.

endif

config UTOPIA_GARBAGE_COLLECTION
bool "Enable utopia2k garbage collection"
default n

config UTOPIA_SIZE_CUSTOMER
	bool "Utopia API relation for reduce size"
	default n

config UTOPIA_SHM_EXPAND_SUPPORT
	bool "Enable msos shared memory expanding"
	default n

config UTOPIA_PROC_DBG_SUPPORT
	bool "Enable proc debug"
	default n
endmenu
```

## UTPA2-700.0.x/modules/mspi/drv/mspi/Kconfig
```kconfig
config DRV_MSPI

tristate "MSPI"
default n

---help---
Enable compilation option for driver MSPI
```

## UTPA2-700.0.x/modules/mvop/drv/mvop/Kconfig
```kconfig
config DRV_MVOP

tristate "MVOP"
default n

---help---
Enable compilation option for driver MVOP
```

## UTPA2-700.0.x/modules/njpd/api/njpeg_ex/Kconfig
```kconfig
config API_NJPEG_EX

tristate "NJPEG_EX"
default n

---help---
Enable compilation option for API NJPEG_EX
```

## UTPA2-700.0.x/modules/njpd/drv/njpd_ex/Kconfig
```kconfig
config DRV_NJPD_EX

tristate "NJPD_EX"
default n

---help---
Enable compilation option for driver NJPD_EX
```

## UTPA2-700.0.x/modules/ojpd_vdec_v1/api/jpeg/Kconfig
```kconfig
config API_JPEG

tristate "JPEG"
default n

---help---
Enable compilation option for API JPEG
```

## UTPA2-700.0.x/modules/ojpd_vdec_v1/drv/jpd/Kconfig
```kconfig
config DRV_JPD

tristate "JPD"
default n

---help---
Enable compilation option for driver JPD
```

## UTPA2-700.0.x/modules/ojpd_vdec_v2/api/jpeg_ex/Kconfig
```kconfig
config API_JPEG_EX

tristate "JPEG_EX"
default n

---help---
Enable compilation option for API_JPEG_EX
```

## UTPA2-700.0.x/modules/ojpd_vdec_v2/drv/jpd_ex/Kconfig
```kconfig
config DRV_JPD_EX

tristate "JPD_EX"
default n

---help---
Enable compilation option for driver JPD_EX
```

## UTPA2-700.0.x/modules/pcmcia/drv/pcmcia/Kconfig
```kconfig
config DRV_PCMCIA

tristate "PCMCIA"
default n

---help---
Enable compilation option for driver PCMCIA

if DRV_PCMCIA

config PCMCIA_MSPI
	bool "MOLESKINE PCMCIA"
	default n
	help
	  Select if project MOLESKINE
	  
config PCMCIA_MSPI_BURST
	bool "BURST mode"
	depends on PCMCIA_MSPI
	default n
	help
	  Select if PCMCIA burst mode
	  
endif	  
```

## UTPA2-700.0.x/modules/pm/drv/pm/Kconfig
```kconfig
config DRV_PM

tristate "PM"
default n

---help---
Enable compilation option for driver PM
```

## UTPA2-700.0.x/modules/pq/drv/pq/Kconfig
```kconfig
config DRV_PQ

tristate "PQ"
default n

---help---
Enable compilation option for driver VE
```

## UTPA2-700.0.x/modules/pvr_iframelut/drv/pvr_iframelut/Kconfig
```kconfig
config DRV_PVR_IFRAMELUT

tristate "PVR_IFRAMELUT"
default n

---help---
Enable compilation option for driver PVR_IFRAMELUT

if DRV_PVR_IFRAMELUT
config PVR_IFRAMELUT_UTPA2_ENABLE
    bool "Enable PVR IframeLUT Utopia2.0"
    default y
    help
       Select if you want to enable Utopia2.0
endif
```

## UTPA2-700.0.x/modules/pwm/drv/pwm/Kconfig
```kconfig
config DRV_PWM

tristate "PWM"
default n

---help---
Enable compilation option for driver PWM
```

## UTPA2-700.0.x/modules/pws/drv/pws/Kconfig
```kconfig
config DRV_PWS

tristate "PWS"
default n

---help---
Enable compilation option for driver PWS
```

## UTPA2-700.0.x/modules/rtc/drv/rtc/Kconfig
```kconfig
config DRV_RTC

tristate "RTC"
default n

---help---
Enable compilation option for driver RTC
```

## UTPA2-700.0.x/modules/sar/drv/sar/Kconfig
```kconfig
config DRV_SAR

tristate "SAR"
default n

---help---
Enable compilation option for driver SAR

config MSTAR_UTPA2K_SAR_ENABLE
    bool "Enable Mstar UTPA2K SAR"
    default n
    help
       Select if you want to enable UTPA2K

config MSTAR_T_SENSOR_ENABLE
    bool "Enable Mstar T Sesnor"
    default n
    help
       Select if you want to enable T Sensor

config MSTAR_DVFS_ENABLE
    bool "Enable Mstar DVFS"
    depends on DRV_SAR
    depends on (EXT_PLATFORM_FLAG="general") || (EXT_PLATFORM_FLAG="tvos")
    default n
    help
        Select if you want to enable DVFS. If unsure, say 'N'.

config MSTAR_DVFS_KERNEL_SUPPORT
    bool "Enable Mstar DVFS Flow in Linux Kernel"
    depends on DRV_SAR
    depends on (EXT_PLATFORM_FLAG="general") || (EXT_PLATFORM_FLAG="tvos")
    default n
    help
        Select if you want to enable DVFS. If unsure, say 'N'.
```

## UTPA2-700.0.x/modules/sc/drv/sc/Kconfig
```kconfig
config DRV_SC

tristate "SC"
default n

---help---
Enable compilation option for driver SC
```

## UTPA2-700.0.x/modules/seal/drv/seal/Kconfig
```kconfig
config DRV_SEAL

tristate "SEAL"
default n

---help---
Enable compilation option for driver SEAL
```

## UTPA2-700.0.x/modules/security/drv/aesdma/Kconfig
```kconfig
config DRV_AESDMA

tristate "AESDMA"
default n

---help---
Enable compilation option for driver AESDMA
```

## UTPA2-700.0.x/modules/security/drv/cipher/Kconfig
```kconfig
config DRV_CIPHER

tristate "CIPHER"
default n

---help---
Enable compilation option for driver CIPHER

if DRV_CIPHER
config CIPHER_UTOPIA_20_ENABLE
	bool "Enable CIPHER 20"
	default y
	help
	  Select if you want to enable CIPHER Utopia 2_0. If unsure, say 'Y'.
config CIPHER_NO_PRINTF_ENABLE
	bool "Enable No Print Message"
	default n
	help
	  Select if you want to remove printf message. If unsure, say 'N'.
endif
```
