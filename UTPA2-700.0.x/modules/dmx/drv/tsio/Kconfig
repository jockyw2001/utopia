## UTPA2-700.0.x/modules/dmx/drv/tsio/Kconfig
```kconfig
config DRV_TSIO

tristate "TSIO"
default n

---help---
Enable compilation option for driver TSIO
```

## UTPA2-700.0.x/modules/dmx/drv/tso2/Kconfig
```kconfig
config DRV_TSO

tristate "TSO"
default n

---help---
Enable compilation option for driver TSO
```

## UTPA2-700.0.x/modules/dmx/drv/tsp/Kconfig
```kconfig
config DRV_TSP

tristate "TSP"
default n

---help---
Enable compilation option for driver TSP
```

## UTPA2-700.0.x/modules/dmx/drv/tsp3/Kconfig
```kconfig
config DRV_TSP3

tristate "TSP3"
default n

---help---
Enable compilation option for driver TSP3
```

## UTPA2-700.0.x/modules/dmx/drv/tsp4/Kconfig
```kconfig
config DRV_TSP2

tristate "TSP2"
default n

---help---
Enable compilation option for driver TSP2
```

## UTPA2-700.0.x/modules/dmx/drv/tsp_tee/Kconfig
```kconfig
config DRV_TSP_TEE

tristate "TSP_TEE"
default n

---help---
Enable compilation option for driver TSP_TEE
```

## UTPA2-700.0.x/modules/dscmb/api/nsk2hdi/Kconfig
```kconfig
config API_NSK2

tristate "NSK2"
default n

---help---
Enable compilation option for API NSK2
```

## UTPA2-700.0.x/modules/dscmb/drv/ca2/Kconfig
```kconfig
config DRV_CA2

tristate "CA2"
default n

---help---
Enable compilation option for driver CA

if DRV_CA2
config CA2_UTOPIA_20_ENABLE
	bool "Enable CA2 20"
	default y
	help
	  Select if you want to enable CA2 Utopia 2_0. If unsure say 'Y'.

config CA2_NO_PRINTF_ENABLE
	bool "Enable No Print Message"
	default n
	help
	  Select if you want to remove printf message. If unsure, say 'N'.
endif
```

## UTPA2-700.0.x/modules/dscmb/drv/dscmb/Kconfig
```kconfig
config DRV_DSCMB

tristate "DSCMB"
default n

---help---
Enable compilation option for driver DSCMB

if DRV_DSCMB
config DSCMB_CSA_ENABLE
	bool "Enable dscmb CSA"
	default n
	help
	  Select if you want to enable dscmb CSA. If unsure, say 'N'.

config DSCMB_MULTI2_ENABLE
	bool "Enable dscmb MLUTI2"
	default y
	help
	  Select if you want to enable dscmb MULTI2. If unsure, say 'N'.
endif
```

## UTPA2-700.0.x/modules/dscmb/drv/dscmb2/Kconfig
```kconfig
config DRV_DSCMB2

tristate "DSCMB2"
default n

---help---
Enable compilation option for driver DSCMB2

if DRV_DSCMB2
config DSCMB2_UTOPIA_20_ENABLE
	bool "Enable DSCMB2 20"
	default y
	help
	  Select if you want to enable DSCMB2 Utopia 2_0. If unsure, say 'Y'.

config DSCMB2_NSK_ENABLE
	bool "Enable DSCMB2 NSK"
	default n
	help
	  Select if you want to enable DSCMB2 NSK. If unsure, say 'N'.

config DSCMB2_MULTI2_ENABLE
	bool "Enable DSCMB2 MLUTI2"
	default n
	help
	  Select if you want to enable DSCMB2 MULTI2. If unsure, say 'N'.

config DSCMB2_NO_PRINTF_ENABLE
	bool "Enable No Print Message"
	default n
	help
	  Select if you want to remove printf message. If unsure, say 'N'.

config DSCMB2_HW_SEM_ENABLE
	bool "Enable HW SEM"
	default n
	help
	  Select if you want to enable HW SEM. If unsure, say 'N'.


config DSCMB2_SECURE_MODE_ENABLE
	bool "Enable Secure Mode"
	depends on DSCMB2_HW_SEM_ENABLE
	default n
	help
	  Select if you want to enable secure mode. If unsure, say 'N'.

endif
```

## UTPA2-700.0.x/modules/dscmb/drv/nds/Kconfig
```kconfig
config DRV_NDS

tristate "NDS"
default n

---help---
Enable compilation option for driver NDS
```

## UTPA2-700.0.x/modules/dscmb/drv/nsk2/Kconfig
```kconfig
config DRV_NSK2

tristate "NSK2"
default n

---help---
Enable compilation option for driver NSK2
```

## UTPA2-700.0.x/modules/dscmb/drv/tcf/Kconfig
```kconfig
config DRV_TCF

tristate "TCF"
default n

---help---
Enable compilation option for driver TCF
```

## UTPA2-700.0.x/modules/flash/drv/flash/Kconfig
```kconfig
config DRV_FLASH

tristate "FLASH"
default n

---help---
Enable compilation option for driver flash

if DRV_FLASH
source "../../mxlib/drv/flash/nor/Kconfig"
source "../../mxlib/drv/flash/serial/Kconfig"
endif
```

## UTPA2-700.0.x/modules/flash/drv/flash/nor/Kconfig
```kconfig
config DRV_NOR_FLASH

bool "Apply nor flash device"
default n

---help---
Enable compilation option for driver NOR_FLASH
```

## UTPA2-700.0.x/modules/flash/drv/flash/serial/Kconfig
```kconfig
config DRV_SERIAL_FLASH

bool "Apply serial flash device"
default n

---help---
Enable compilation option for driver SERIAL_FLASH
```

## UTPA2-700.0.x/modules/gpd/api/gpd/Kconfig
```kconfig
config API_GPD

tristate "GPD"
default n

---help---
Enable compilation option for API GPD
```

## UTPA2-700.0.x/modules/gpd/drv/gpd/Kconfig
```kconfig
config DRV_GPD

tristate "GPD"
default n

---help---
Enable compilation option for driver GPD
```

## UTPA2-700.0.x/modules/gpio/drv/gpio/Kconfig
```kconfig
config DRV_GPIO

tristate "GPIO"
default n

---help---
Enable compilation option for driver GPIO

config MSTAR_UTPA2K_GPIO_ENABLE
    bool "Enable Mstar UTPA2K GPIO"
    default n
    help
       Select if you want to enable UTPA2K
```

## UTPA2-700.0.x/modules/graphic/api/gfx/Kconfig
```kconfig
config API_GFX

tristate "GFX"
default n

---help---
Enable compilation option for API GFX
if API_GFX
config GFX_TEXTOUT
	bool "Enable GFX TEXTOUT"
	default y
	help
	  Select if you want to enable GFX TEXTOUT. If unsure, say 'N'.

config GFX_TRAPZOID
	bool "Enable GFX TRAPZOID"
	default y
	help
	  Select if you want to enable GFX TRAPZOID. If unsure, say 'N'.
endif
```

## UTPA2-700.0.x/modules/graphic/api/gop/Kconfig
```kconfig
config API_GOP

tristate "GOP"
default n

---help---
Enable compilation option for API GOP
if API_GOP
config GOP_POOL_ARRANGE
	bool "Enable GOP POOL ARRANGE"
	default y
	help
	  Select if you want to enable GOP POOL ARRANGE. If unsure, say 'N'.

config GOP_GWIN_MISC
	bool "Enable GOP GWIN MISC"
	default y
	help
	  Select if you want to enable GOP GWIN MISC. If unsure, say 'N'.
	  
config GOP_2ND_PAL
	bool "Enable GOP 2ND PAL"
	default y
	help
	  Select if you want to enable GOP 2ND Palette. If unsure, say 'N'.
	  
config GOP_BG
	bool "Enable GOP POOL ARRANGE"
	default y
	help
	  Select if you want to enable GOP Back Ground. If unsure, say 'N'.
	  
config GOP_FADE
	bool "Enable GOP FADE"
	default y
	help
	  Select if you want to enable GOP FADE. If unsure, say 'N'.	  	  	  

config GOP_YUV_SWAP
	bool "Enable GOP POOL ARRANGE"
	default y
	help
	  Select if you want to enable GOP YUV SWAP. If unsure, say 'N'.
	  
config GOP_CONTRAST
	bool "Enable GOP CONTRAST"
	default y
	help
	  Select if you want to enable GOP CONTRAST. If unsure, say 'N'.	  

config GOP_VE_CAPTURE
	bool "Enable GOP VE CAPTURE"
	default y
	help
	  Select if you want to enable GOP VE CAPTURE. If unsure, say 'N'.
	  
config GOP_SCROLL
	bool "Enable GOP SCROLL"
	default y
	help
	  Select if you want to enable GOP SCROLL. If unsure, say 'N'.	 
	  
config GOP_TEST_PATTERN
	bool "Enable GOP TEST PATTERN"
	default y
	help
	  Select if you want to enable GOP TEST PATTERN. If unsure, say 'N'.

config GOP_DISABLE_GFLIP
	bool "Disabel GOP GFLIP"
	default n
	help
	  Select if you want to disable GOP GFLIP. If unsure, say 'N'.

endif
```

## UTPA2-700.0.x/modules/graphic/api/gopsc/Kconfig
```kconfig
config API_GOPSC

tristate "GOPSC"
default n

---help---
Enable compilation option for API GOPSC
```

## UTPA2-700.0.x/modules/graphic/api/gopscd/Kconfig
```kconfig
config API_GOPSCD

tristate "GOPSCD"
default n

---help---
Enable compilation option for API GOPSCD
```

## UTPA2-700.0.x/modules/graphic/drv/ge/Kconfig
```kconfig
config DRV_GE

tristate "GE"
default n

---help---
Enable compilation option for driver GE
```

## UTPA2-700.0.x/modules/graphic/drv/gop/Kconfig
```kconfig
config DRV_GOP

tristate "GOP"
default n

---help---
Enable compilation option for driver GOP
```
